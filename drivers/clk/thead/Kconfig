## drivers/clk/thead/Kconfig
```kconfig
#SPDX-License-Identifier: GPL-2.0

config CLK_THEAD_TH1520_AP
	bool "T-HEAD TH1520 AP clock support"
	depends on ARCH_THEAD || COMPILE_TEST
	depends on 64BIT
	default ARCH_THEAD
	select REGMAP_MMIO
	help
	  Say yes here to support the AP sub system clock controller
	  on the T-HEAD TH1520 SoC. This includes configuration of
	  both CPU PLLs, both DPU PLLs as well as the GMAC, VIDEO,
	  and TEE PLLs.

config THEAD_CLK
	bool
	def_bool ARCH_XUANTIE

config CLK_TH1520_FM
	bool "XuanTie Th1520 Fullmask Clock Driver"
	depends on ARCH_XUANTIE
	default n
	help
	    Build the driver for th1520 fullmask Clock Driver
```
